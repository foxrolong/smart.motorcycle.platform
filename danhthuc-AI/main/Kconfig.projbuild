## danhthuc-AI/main/Kconfig.projbuild
```kconfig
menu "Foxro Application Configuration"

    menu "RGB LED GPIO Configuration"
        comment "Cấu hình chân GPIO điều khiển 3 đèn LED RGB (R/G/B riêng biệt)"
        comment "Đổi theo sơ đồ phần cứng board của bạn"

        config LED_R_GPIO
            int "LED Red GPIO number"
            default 45
            range 0 48
            help
                Chân GPIO kết nối đèn LED màu ĐỎ.
                Logic: Active HIGH (GPIO=1 => đèn BẬT).
                Thường nối: GPIO -> điện trở 220Ω -> LED Đỏ -> GND.

        config LED_G_GPIO
            int "LED Green GPIO number"
            default 46
            range 0 48
            help
                Chân GPIO kết nối đèn LED màu XANH LÁ.

        config LED_B_GPIO
            int "LED Blue GPIO number"
            default 47
            range 0 48
            help
                Chân GPIO kết nối đèn LED màu XANH DƯƠNG.
    endmenu

    menu "Microphone I2S Configuration (INMP441)"
        comment "Cấu hình I2S cho Micro INMP441 (thu âm 16kHz mono)"

        config MIC_I2S_BCLK_GPIO
            int "I2S Bit Clock GPIO (BCLK / SCK)"
            default 5
            range 0 48
            help
                Chân GPIO kết nối đến chân SCK (Serial Clock) của INMP441.

        config MIC_I2S_WS_GPIO
            int "I2S Word Select GPIO (WS / LRCLK)"
            default 4
            range 0 48
            help
                Chân GPIO kết nối đến chân WS (Word Select) của INMP441.
                Xác định kênh trái/phải. Nối L/R của INMP441 vào GND để chọn kênh trái.

        config MIC_I2S_DIN_GPIO
            int "I2S Data Input GPIO (DIN / SD)"
            default 6
            range 0 48
            help
                Chân GPIO nhận dữ liệu âm thanh từ INMP441 (chân SD của INMP441).
    endmenu

    menu "Wake Word Behavior"
        config LED_ON_DURATION_MS
            int "LED ON duration after wake word detected (ms)"
            default 3000
            range 2000 4000
            help
                Thời gian LED sáng sau khi phát hiện từ khóa đánh thức.
                Phạm vi: 2000ms (2 giây) đến 4000ms (4 giây).
                Mặc định: 3000ms (3 giây).

        config DEEP_SLEEP_DURATION_SEC
            int "Deep sleep duration before re-listening (seconds)"
            default 30
            range 5 3600
            help
                Thời gian deep sleep trước khi chip tự động thức dậy và
                lắng nghe wake word lại.
                Đặt giá trị lớn để tiết kiệm điện tối đa.
    endmenu

endmenu
```

## danhthuc-AI/sdkconfig.defaults.esp32s3
```kconfig
# ESP32-S3 Specific Configuration
# Áp dụng khi target là esp32s3: idf.py set-target esp32s3

# ── Flash ─────────────────────────────────────────────────────────────────
CONFIG_ESPTOOLPY_FLASHSIZE_16MB=y
CONFIG_ESPTOOLPY_FLASHMODE_QIO=y

# ── Cache ─────────────────────────────────────────────────────────────────
CONFIG_ESP32S3_INSTRUCTION_CACHE_32KB=y
CONFIG_ESP32S3_DATA_CACHE_64KB=y
CONFIG_ESP32S3_DATA_CACHE_LINE_64B=y

# ── PSRAM (Octal SPIRAM 80MHz) ────────────────────────────────────────────
# Bật PSRAM nếu board có (ESP32-S3-DevKitC-1 N16R8 có 8MB PSRAM)
# esp-sr AFE ưu tiên cấp phát buffer vào PSRAM để giải phóng SRAM nội
CONFIG_SPIRAM=y
CONFIG_SPIRAM_MODE_OCT=y
CONFIG_SPIRAM_SPEED_80M=y
# Cấp phát < 4KB từ SRAM nội để tốc độ cao, >= 4KB từ PSRAM
CONFIG_SPIRAM_MALLOC_ALWAYSINTERNAL=4096
```

## foxro/sdkconfig.defaults
```kconfig
# Foxro - Default SDK Configuration
# Tối ưu cho ESP32-S3 với Wake Word Detection (esp-sr)
# Sử dụng với: idf.py -DSDKCONFIG_DEFAULTS="sdkconfig.defaults;sdkconfig.defaults.esp32s3" build

# ── CPU Performance ────────────────────────────────────────────────────────
# Chạy CPU ở tần số tối đa 240MHz để WakeNet inference chạy nhanh
CONFIG_ESP_DEFAULT_CPU_FREQ_MHZ_240=y

# ── Tối ưu Bootloader ─────────────────────────────────────────────────────
CONFIG_BOOTLOADER_LOG_LEVEL_NONE=y
CONFIG_BOOTLOADER_COMPILER_OPTIMIZATION_PERF=y

# ── NVS ───────────────────────────────────────────────────────────────────
CONFIG_NVS_ASSERT_ERROR_CHECK=n

# ── Log Level ─────────────────────────────────────────────────────────────
# INFO level để xem được log debug trong quá trình phát triển
CONFIG_LOG_DEFAULT_LEVEL_INFO=y

# ── esp-sr: WakeNet Model ─────────────────────────────────────────────────
# Kích hoạt WakeNet và chọn model "Hi Lily" (tương thích esp-sr ^1.9.0)
CONFIG_USE_WAKENET=y
CONFIG_SR_WN_WN9_HILILI_TTS=y

# ── FreeRTOS ──────────────────────────────────────────────────────────────
# Tick rate 1000Hz để vTaskDelay(pdMS_TO_TICKS(1)) = 1ms chính xác
CONFIG_FREERTOS_HZ=1000

# ── Partition Table ───────────────────────────────────────────────────────
# Dùng partition table tùy chỉnh có entry 'model' cho WakeNet model
CONFIG_PARTITION_TABLE_CUSTOM=y
CONFIG_PARTITION_TABLE_CUSTOM_FILENAME="partitions.csv"
CONFIG_PARTITION_TABLE_OFFSET=0x8000

# ── Deep Sleep ────────────────────────────────────────────────────────────
# Tắt hoàn toàn nguồn 32kHz OSC khi deep sleep (tiết kiệm điện ~6µA)
CONFIG_ESP_SLEEP_RTC_USE_RC_FAST_CLOCK=y
```
